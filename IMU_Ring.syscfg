/**
 * @cliArgs --board "/ti/boards/LP_EM_CC2340R5" --device "CC2340R5RKP" --part "Default" --package "RKP" --rtos "freertos" --product "simplelink_lowpower_f3_sdk@9.20.00.81"
 * @versions {"tool":"1.27.1+4634"}
 */

/**
 * Import the modules used in this configuration.
 */
const FreeRTOS   = scripting.addModule("/freertos/FreeRTOS");
const ble        = scripting.addModule("/ti/ble/ble");
const CCFG       = scripting.addModule("/ti/devices/CCFG");
const rfdesign   = scripting.addModule("/ti/devices/radioconfig/rfdesign");
const Display    = scripting.addModule("/ti/display/Display", {}, false);
const Display1   = Display.addInstance();
const AESCCM     = scripting.addModule("/ti/drivers/AESCCM");
const AESCCM2    = AESCCM.addInstance();
const AESCTRDRBG = scripting.addModule("/ti/drivers/AESCTRDRBG");
const AESECB     = scripting.addModule("/ti/drivers/AESECB");
const AESECB2    = AESECB.addInstance();
const ECDH       = scripting.addModule("/ti/drivers/ECDH");
const ECDH2      = ECDH.addInstance();
const GPIO       = scripting.addModule("/ti/drivers/GPIO");
const GPIO1      = GPIO.addInstance();
const GPIO2      = GPIO.addInstance();
const GPIO3      = GPIO.addInstance();
const NVS        = scripting.addModule("/ti/drivers/NVS");
const NVS1       = NVS.addInstance();
const Power      = scripting.addModule("/ti/drivers/Power");
const RCL        = scripting.addModule("/ti/drivers/RCL");
const RNG        = scripting.addModule("/ti/drivers/RNG");
const SPI        = scripting.addModule("/ti/drivers/SPI", {}, false);
const SPI1       = SPI.addInstance();
const Button     = scripting.addModule("/ti/drivers/apps/Button", {}, false);
const Button1    = Button.addInstance();
const Button2    = Button.addInstance();
const Settings   = scripting.addModule("/ti/posix/freertos/Settings");

/**
 * Write custom configuration values to the imported modules.
 */
FreeRTOS.heapSize       = 0x00004D50;
FreeRTOS.timerStackSize = 0x00000190;
FreeRTOS.idleStackSize  = 0x00000130;

ble.basicBLE                                                   = true;
ble.disDevBySerUuid                                            = true;
ble.numOfAdvSets                                               = 1;
ble.deviceName                                                 = "BLE Ring";
ble.paramUpdateReq                                             = "GAP_UPDATE_REQ_ACCEPT_ALL";
ble.maxPDUSize                                                 = 247;
ble.maxPDUNum                                                  = 8;
ble.radioConfig.codeExportConfig.$name                         = "ti_devices_radioconfig_code_export_param0";
ble.adcNoiseConfig.codeExportConfig.$name                      = "ti_devices_radioconfig_code_export_param1";
ble.bleCsConfig.codeExportConfig.$name                         = "ti_devices_radioconfig_code_export_param2";
ble.connUpdateParamsPeripheral.$name                           = "ti_ble_general_ble_conn_update_params0";
ble.advSet1.$name                                              = "ti_ble_broadcaster_advertisement_set0";
ble.advSet1.advParam1.$name                                    = "ti_ble_broadcaster_advertisement_params0";
ble.advSet1.advData1.$name                                     = "ti_ble_broadcaster_advertisement_data0";
ble.advSet1.advData1.GAP_ADTYPE_16BIT_MORE                     = true;
ble.advSet1.advData1.numOfUUIDs16More                          = 1;
ble.advSet1.advData1.UUID016More                               = 0xFFF0;
ble.advSet1.scanRes1.$name                                     = "ti_ble_broadcaster_advertisement_data1";
ble.advSet1.scanRes1.GAP_ADTYPE_PERIPHERAL_CONN_INTERVAL_RANGE = true;
ble.rng.$name                                                  = "CONFIG_RNG_0";
ble.aesccm.$name                                               = "CONFIG_AESCCM_0";
ble.ecdh.$name                                                 = "CONFIG_ECDH_0";
ble.aesctrdrbg.$name                                           = "CONFIG_AESCTRDRBG_0";
ble.aesecb.$name                                               = "CONFIG_AESECB_0";

CCFG.ccfgTemplate.$name = "ti_devices_CCFG_CCFGCC23X0Template0";

Display1.$name      = "CONFIG_Display_0";
Display1.$hardware  = system.deviceData.board.components.XDS110UART;
Display1.uart.$name = "CONFIG_UART2_0";

AESCCM2.$name = "CONFIG_AESCCM0";

AESECB2.$name = "CONFIG_AESECB0";

ECDH2.$name = "CONFIG_ECDH0";

GPIO1.$hardware = system.deviceData.board.components.LED_GREEN;
GPIO1.$name     = "CONFIG_GPIO_LED_GREEN";

GPIO2.$hardware = system.deviceData.board.components.LED_RED;
GPIO2.$name     = "CONFIG_GPIO_LED_RED";

GPIO3.$name              = "CONFIG_GPIO_0";
GPIO3.mode               = "Output";
GPIO3.initialOutputState = "High";
GPIO3.gpioPin.$assign    = "boosterpack.10";

NVS1.$name                    = "CONFIG_NVSINTERNAL";
NVS1.internalFlash.$name      = "ti_drivers_nvs_NVSLPF30";
NVS1.internalFlash.regionBase = 0x7D000;
NVS1.internalFlash.regionSize = 0x3000;

RNG.rngReturnBehavior      = "RNG_RETURN_BEHAVIOR_BLOCKING";
RNG.noiseConditioningKeyW3 = 0x3CF4112E;

SPI1.$name       = "CONFIG_SPI_0";
SPI1.spi.$assign = "SPI0";

Button1.$name     = "CONFIG_BUTTON_0";
Button1.$hardware = system.deviceData.board.components["BTN-1"];

Button2.$name     = "CONFIG_BUTTON_1";
Button2.$hardware = system.deviceData.board.components["BTN-2"];

const AESCommonXXF3 = scripting.addModule("/ti/drivers/cryptoutils/aes/AESCommonXXF3", {}, false);

/**
 * Pinmux solution for unlocked pins/peripherals. This ensures that minor changes to the automatic solver in a future
 * version of the tool will not impact the pinmux you originally saw.  These lines can be completely deleted in order to
 * re-solve from scratch.
 */
Display1.uart.uart.$suggestSolution                  = "UART0";
Display1.uart.uart.dmaTxChannel.$suggestSolution     = "DMA_CH2";
Display1.uart.uart.dmaRxChannel.$suggestSolution     = "DMA_CH3";
Display1.uart.uart.txPin.$suggestSolution            = "boosterpack.4";
GPIO1.gpioPin.$suggestSolution                       = "boosterpack.40";
GPIO2.gpioPin.$suggestSolution                       = "boosterpack.39";
SPI1.spi.sclkPin.$suggestSolution                    = "boosterpack.9";
SPI1.spi.dmaRxChannel.$suggestSolution               = "DMA_CH1";
SPI1.spi.dmaTxChannel.$suggestSolution               = "DMA_CH0";
SPI1.spi.pociPin.$suggestSolution                    = "boosterpack.37";
SPI1.spi.picoPin.$suggestSolution                    = "boosterpack.17";
Button1.button.$suggestSolution                      = "boosterpack.13";
Button2.button.$suggestSolution                      = "boosterpack.12";
AESCommonXXF3.laes.$suggestSolution                  = "LAES";
AESCommonXXF3.laes.dataLaesChannelA.$suggestSolution = "DMA_CH4";
AESCommonXXF3.laes.dataLaesChannelB.$suggestSolution = "DMA_CH5";
